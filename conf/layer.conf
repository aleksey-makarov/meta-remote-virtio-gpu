## conf/layer.conf
```bitbake
# We have a conf and classes directory, add to BBPATH
BBPATH .= ":${LAYERDIR}"

# We have recipes-* directories, add to BBFILES
BBFILES += "${LAYERDIR}/recipes-*/*/*.bb \
            ${LAYERDIR}/recipes-*/*/*.bbappend"

BBFILE_COLLECTIONS += "meta-remote-virtio-gpu"
BBFILE_PATTERN_meta-remote-virtio-gpu = "^${LAYERDIR}/"
BBFILE_PRIORITY_meta-remote-virtio-gpu = "6"

LAYERDEPENDS_meta-remote-virtio-gpu = "core"
LAYERSERIES_COMPAT_meta-remote-virtio-gpu = "mickledore"
```
